## arch/arm/mach-pnx67xx/Kconfig
```kconfig
comment "PNX67XX Core Type"
	depends on ARCH_PNX67XX

choice
	prompt "Choose the PNX67XX Core Type"
	default ARCH_PNX67XX_V2
	depends on ARCH_PNX67XX
	help
		"Choose the PNX67XX Core Type Version"
	config ARCH_PNX67XX_V2
		bool "PNX67XX_V2"
endchoice

comment "PNX67XX Board Type"
	depends on ARCH_PNX67XX

choice
	prompt "Choose the PNX67XX V2 Board type"
	default MACH_PNX67XX_V2_E150C_2GB
	depends on ARCH_PNX67XX_V2
	help
		"Choose the ST-Ericsson Reference Design Board"
	config MACH_PNX67XX_V2_WAVEB_2GB
		bool "PNX67XX V2 WaveB Board with Micron combo"
	config MACH_PNX67XX_V2_WAVEC_2GB
		bool "PNX67XX V2 WaveC Board with Micron combo"
	config MACH_PNX67XX_V2_E150B_2GB
		bool "PNX67XX V2 E150B Board with 2Gb Micron combo"
	config MACH_PNX67XX_V2_E150C_2GB
		bool "PNX67XX V2 E150C Board with 2Gb Micron combo"
	config MACH_PNX67XX_V2_E150D_2GB
		bool "PNX67XX V2 E150D Board with 2Gb Micron combo"

endchoice

choice
	prompt "Choose target Memory Combo"
	default MEMCOMBO_MT29C2G24MAJJAJC
	help 
	  Select which memory combo is to be supported.
	  Currently, only Micron combos are specified, as supported on
	  reference design boards (waveB, waveC, waveD).
	config MEMCOMBO_MT29C2G24MAJJAJC
		bool "Micron 2Gb Nand / 1Gb DDR"
	config MEMCOMBO_MT29C2G48MAJAMAKC
		bool "Micron 2Gb Nand / 2Gb DDR"
	config MEMCOMBO_K524F2HACMB050
		bool "Samsung 2Gb Nand / 2Gb DDR"
endchoice

comment "PNX67XX Specific configuration"
	depends on ARCH_PNX67XX

config MACHINE_NAME
	prompt "Machine Name"
	depends on ARCH_PNX
	default "STE_PNX67xx_refd"
	string
	help
		Change the machine name for application framework convenience
		It will be set in board_pnx*.c file

config ANDROID
	prompt "Android specific for PNX67xx"
	depends on ARCH_PNX
	default n
	bool
	help
		Change to activate Android PNX platform specific feature
		Like specific MTD partitions in board file...

config ANDROID_RECOVERY
	prompt "Android recovery support"
	depends on ANDROID
	default n
	bool
	help
	 Enable MTD partition table with "boot,recovery,misc,cache" 
	 partitions. If not set old mtd partition is used with
	 a specific rootfs partition defined

# ACER Bright Lee, 2009/11/11, Remove the setting from here to src/acer_AU*_def.h {
# config PMEM_POOL_START_ADDR
	# depends on ARCH_PNX67XX && ANDROID_PMEM
	# hex "Physical start pool address for pmem "
	# default 0x22800000
	# help
	 # must be page align (4K by default)
	 # be aware this address must be compatible with your RAM mapping
	 # this memory pool is used by our PNX video accelarators

# config PMEM_POOL_SIZE
	# depends on ARCH_PNX67XX && ANDROID_PMEM
	# hex "pmem pool size in bytes"
	# default 0x1000000
	# help
	 # must by a 4K page multiple, be aware this size (default 16 Mbytes)
	 # must be compatible with your RAM mapping and multimedia use cases
# } ACER Bright Lee, 2009/11/11

config DCXO_AFC
	depends on ARCH_PNX67XX
	bool "DCXO main clock compatibility feature"
	help
	 This flag is used to set the gpio of the DCXO main clock to the right
	 configuration, otherwise it is not set. RTK must be aligned
	 (DCXO_AFC_FTR).

config MACH_PNX_REALLOC
	bool "Modem and Linux Memory mappings compatible with Linux requirements"
	depends on ARCH_PNX67XX && NKERNEL
	help
	 activate memory mapping compatible with Linux requirements

config MODEM_MEM_UNMAP
	bool "Modem memory area are no more visible from Linux"
	depends on ARCH_PNX67XX && NKERNEL
	help
		Protect modem memory area from Linux kernel
choice
	prompt "Choose Max ARM Clock frequency"
	default ARMCLOCK_468_MHZ_MAX
	help
	  Select the maximum frequency of ARM clock to be supported.
	  If 468Mhz selected, the 4 operating point are 104-234-312-468 Mhz
  	  If 416Mhz selected, the 4 operating point are 104-208-312-416 Mhz
  	config ARMCLOCK_468_MHZ_MAX
		bool "Maximum ARM Clock at 468 Mhz"
	config ARMCLOCK_416_MHZ_MAX
		bool "Maximum ARM clock at 416 Mhz"
endchoice


# ACER_Ed for TI BT6450
config BT_NSHUTDOWN
   tristate "ENABLE BT_NSHUTDOWN"
   default M
   help
      Enable compilation option for BT6450 chip

#ACER Ed 20100316 for STE BT STLC25XX
config STE_STLC25XX
   tristate "ENABLE STE_BT"
   default M
   help
      Enable compilation option for STE BT chip

#ACER Ed 2010-04-14 for wlan power control
config WLAN_PW
   tristate "ENABLE WLAN_PW"
   default M
   help
      Enable compilation option for wlan power control 
```

## arch/arm/plat-pnx/Kconfig
```kconfig
if ARCH_PNX

menu "STE PNX Implementations"

choice
	prompt "PNX System Type"
	default ARCH_PNX67XX

config ARCH_PNX67XX
	bool "STE PNX67XX"
	select CPU_ARM926T
	select PNX_CLOCKEVENTS
endchoice

comment "STE Feature Selections"

config BOOTTIME
	bool "Linux Boot Time monitoring char device"
		depends on NKERNEL
		default y

config DEBUG_BOOTTIME
	bool "Linux Boot Time debug mode"
		depends on BOOTTIME
		default y


config DBG_RAMDUMP
	bool "Platform Ramdump debug feature"
	depends on NKERNEL
	default y
	help
		Activate the platform Ramdump feature.
		It allows to extract physical memory content
		for postmortem analysis

config DBG_XOSTRACE
	bool "ProcFS interface for Modem traces"
	depends on NKERNEL
	default y
	help
		Activate Modem Traces feature.
		It allows to extract SpyTracer and Applicative
		traces from Modem

config TEST_KERNEL_PANIC
	bool "SysFS interface for kernel panic generation"
	depends on DBG_RAMDUMP
	default n
	help
		Useful to generate some kernel panic to test
		Ramdump feature for Linux

config MODEM_BLACK_BOX
	bool "Modem HW configuration on Linux side"
	depends on NKERNEL
	default y
	help
		Modem HW configuration located in
		board configuration file.

config EBI_BUS
	bool "EBI bus configuration on Linux side"
	depends on MODEM_BLACK_BOX
	default n
	help
		EBI bus configuration located in
		board configuration file.

endmenu

menu "PNX power management"

source "arch/arm/plat-pnx/Kconfig.power"

endmenu

endif
```

## arch/arm/plat-pnx/Kconfig.power
```kconfig
config PNX_POWER_SYSFS
	bool
	default n

config PNX_POWER_TRACE
	bool "Activate power saving trace"
	default n

config PNX_TIMER_TUNE
	bool "Enable dynamic clock tuning"
	default n

config PNX_MTU_TIMER
	bool
	default n

config PNX_SCTU_TIMER
	bool
	default n

config PNX_RTKE_TIMER
	bool
	default n

config POWER_TIMER_BAGGY
	bool "Enable Baggy timer feature"
	default n

config PNX_CLOCKEVENTS
	bool
	select GENERIC_TIME
	select GENERIC_CLOCKEVENTS
	select PNX_POWER_SYSFS
	select PNX_MTU_TIMER
#	select PNX_SCTU_TIMER
	select PNX_RTKE_TIMER if (NKERNEL)
#	select POWER_TIMER_BAGGY
	default n

config PNX_OLDTICK
	bool
	default n
```

## drivers/i2c/chips/Kconfig
```kconfig
#
# Miscellaneous I2C chip drivers configuration
#
# *** DEPRECATED! Do not add new entries! See Makefile ***
#

menu "Miscellaneous I2C Chip support"

config DS1682
	tristate "Dallas DS1682 Total Elapsed Time Recorder with Alarm"
	depends on EXPERIMENTAL
	help
	  If you say yes here you get support for Dallas Semiconductor
	  DS1682 Total Elapsed Time Recorder.

	  This driver can also be built as a module.  If so, the module
	  will be called ds1682.

config SENSORS_PCF50623
	tristate "STE PCF50623"
	depends on I2C
	help
	  If you say yes here you get support for STE PCF50623
	  PMU (Power Management Unit) chips.

	  This driver can also be built as a module.  If so, the module
	  will be called pcf50623.

config SENSORS_PCF50616
	tristate "STE PCF50616"
	depends on I2C
	help
	  If you say yes here you get support for STE PCF50616
	  PMU (Power Management Unit) chips.

	  This driver can also be built as a module.  If so, the module
	  will be called pcf50616.

config SENSORS_PCF8574
	tristate "Philips PCF8574 and PCF8574A (DEPRECATED)"
	depends on EXPERIMENTAL && GPIO_PCF857X = "n"
	default n
	help
	  If you say yes here you get support for Philips PCF8574 and 
	  PCF8574A chips. These chips are 8-bit I/O expanders for the I2C bus.

	  This driver can also be built as a module.  If so, the module
	  will be called pcf8574.

	  This driver is deprecated and will be dropped soon. Use
	  drivers/gpio/pcf857x.c instead.

	  These devices are hard to detect and rarely found on mainstream
	  hardware.  If unsure, say N.

config PCF8575
	tristate "Philips PCF8575 (DEPRECATED)"
	default n
	depends on GPIO_PCF857X = "n"
	help
	  If you say yes here you get support for Philips PCF8575 chip.
	  This chip is a 16-bit I/O expander for the I2C bus.  Several other
	  chip manufacturers sell equivalent chips, e.g. Texas Instruments.

	  This driver can also be built as a module.  If so, the module
	  will be called pcf8575.

	  This driver is deprecated and will be dropped soon. Use
	  drivers/gpio/pcf857x.c instead.

	  This device is hard to detect and is rarely found on mainstream
	  hardware.  If unsure, say N.

config SENSORS_PCA9539
	tristate "Philips PCA9539 16-bit I/O port (DEPRECATED)"
	depends on EXPERIMENTAL && GPIO_PCA953X = "n"
	help
	  If you say yes here you get support for the Philips PCA9539
	  16-bit I/O port.

	  This driver can also be built as a module.  If so, the module
	  will be called pca9539.

	  This driver is deprecated and will be dropped soon. Use
	  drivers/gpio/pca953x.c instead.

config SENSORS_PCF8591
	tristate "Philips PCF8591"
	depends on EXPERIMENTAL
	default n
	help
	  If you say yes here you get support for Philips PCF8591 chips.

	  This driver can also be built as a module.  If so, the module
	  will be called pcf8591.

	  These devices are hard to detect and rarely found on mainstream
	  hardware.  If unsure, say N.

config SENSORS_MAX6875
	tristate "Maxim MAX6875 Power supply supervisor"
	depends on EXPERIMENTAL
	help
	  If you say yes here you get support for the Maxim MAX6875
	  EEPROM-programmable, quad power-supply sequencer/supervisor.

	  This provides an interface to program the EEPROM and reset the chip.

	  This driver also supports the Maxim MAX6874 hex power-supply
	  sequencer/supervisor if found at a compatible address.

	  This driver can also be built as a module.  If so, the module
	  will be called max6875.

config SENSORS_TSL2550
	tristate "Taos TSL2550 ambient light sensor"
	depends on EXPERIMENTAL
	help
	  If you say yes here you get support for the Taos TSL2550
	  ambient light sensor.

	  This driver can also be built as a module.  If so, the module
	  will be called tsl2550.

config SENSORS_PCA963X
	tristate "Philips PCA963X 4-bit I2C-bus LED"
	depends on I2C && EXPERIMENTAL
	help
	 If you say yes here you get support for the Philips PCA963X
	 4-bit I2C-bus LED.

	 This driver can also be built as a module.  If so, the module
	 will be called pca963X.

config SENSORS_LIS331
        tristate "STMicroelectronics MEMS 3-axis motion sensor"
        depends on I2C
	default n
        help
          If you say yes here you get support for STMicroelectronics
          LIS331 motion sensor chips.

          This driver can also be built as a module.  If so, the module
          will be called lis331.

          This driver is deprecated and will be dropped soon. Use
          lis331 instead.

config FM_TEA5991
        tristate "STMicroelectronics FM module"
        depends on I2C
	default n
        help
          If you say yes here you get support for STMicroelectronics
          LIS331 motion sensor chips.

          This driver can also be built as a module.  If so, the module
          will be called tea5991.

          This driver is deprecated and will be dropped soon. Use
          tea5991 instead.   
                
config SENSORS_CM3623
        tristate "CAPELLA Ambient Light/Proximity Sensor"
        depends on I2C
	default n
        help
          If you say yes here you get support for CAPELLA
           Ambient Light/Proximity Sensor.

          This driver can also be built as a module.  If so, the module
          will be called cm3623.
          
endmenu
```

## drivers/video/pnx/Kconfig
```kconfig
menuconfig FB_LCDBUS
	bool "LCDBUS support"
	depends on FB && ARM && ARCH_PNX
	---help---
	  Support for LCD busses and connected displays.

config FB_LCDBUS_LOGIC_PAGEFAULT
	bool "Framebuffer Pagefault Logic"
	depends on FB_LCDBUS
	default y
	select FB_LCDBUS_LCDFB
	select FB_CFB_FILLRECT
	select FB_CFB_COPYAREA
	select FB_CFB_IMAGEBLIT
	---help---
		When a user writes in the "mmaped" framebuffer memory, the
		pagefault logic starts a timer (linked to the parameter "fps",).
		When this timer expired, the refresh thread is waked up, and a full
		LCD screen update is performed. The refresh thread will do several
		(frames_before_trying_to_sleep) full LCD refresh at "fps" speed, before
		re-invalidated the pages with the zap_page_range function for a future
		wake up with pagefault detections.

config FB_LCDBUS_PAGEFAULT_KERNEL_SPLASH_SCREEN
	bool "Enable Kernel Splash Screen feature for all framebuffers"
	depends on FB_LCDBUS_LOGIC_PAGEFAULT
	default n
	---help---
		Say Y to enable the kernel splash screen feature for all framebuffers.

source "drivers/video/pnx/busses/Kconfig"
source "drivers/video/pnx/displays/Kconfig"

config FB_LCDBUS_DEBUG
	bool "Enable debugging"
	depends on FB_LCDBUS
	---help---
		Say Y here to enable debug messages for the bus and display drivers.


comment "HWMEM Allocator configuration"
	depends on ARCH_PNX

choice
	prompt "Choose HWMEM alloctor configuration"
	default HWMEM_QVGA
	config HWMEM_QVGA
		bool "QVGA configuration"
		help
			Should be selected when using QVGA screen.

	config HWMEM_WQVGA
		bool "WQVGA configuration"
		help
			Should be selected when using WQVGA (Wide QVGA) screen.

endchoice
```

## drivers/video/pnx/busses/Kconfig
```kconfig
menu "Busses"
  depends on FB_LCDBUS

config FB_LCDBUS_LCDCTRL
	tristate
	depends on FB_LCDBUS
	default n

config FB_LCDBUS_VDE
  tristate "Video Display Engine (VDE)"
  depends on FB_LCDBUS
  select FB_LCDBUS_LCDCTRL
  ---help---
    Video Display Engine (VDE) driver for the PNX baseband.

endmenu
```
